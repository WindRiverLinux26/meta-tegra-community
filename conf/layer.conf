## conf/layer.conf
```bitbake
BBPATH .= ":${LAYERDIR}"

BSP_NVIDIA_DERIVED ??= ""
BBFILES += "${@bb.utils.contains_any('MACHINE', '${BSP_NVIDIA_DERIVED}', '${LAYERDIR}/recipes-*/*/*.bb', '', d)}"
BBFILES += "${@bb.utils.contains_any('MACHINE', '${BSP_NVIDIA_DERIVED}', '${LAYERDIR}/recipes-*/*/*.bbappend', '', d)}"

BBFILE_COLLECTIONS += "tegra-community"
BBFILE_PATTERN_tegra-community = "^${LAYERDIR}/"
BBFILE_PRIORITY_tegra-community = "20"

RECIPE_LIST_REASON:tegra-community = "You are about to enable third-party components, there is additional third-part licensing involved, and you might need to consult with your legal department."

LAYERVERSION_tegra-community = "1"
LAYERDEPENDS_tegra-community = "core tegra openembedded-layer meta-python"
LAYERSERIES_COMPAT_tegra-community = "wrynose"
```
